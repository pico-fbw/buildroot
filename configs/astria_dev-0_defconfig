## configs/astria_dev-0_defconfig
```kconfig
# Architecture
BR2_aarch64=y
BR2_cortex_a72=y
BR2_ARM_FPU_VFPV4=y # Hardware floating point
BR2_TOOLCHAIN_BUILDROOT_CXX=y

# System
BR2_TARGET_GENERIC_HOSTNAME="astria"
BR2_TARGET_GENERIC_ISSUE="Welcome to astria!"
BR2_TARGET_GENERIC_ROOT_PASSWD="astria"

# Filesystem
BR2_ROOTFS_DEVICE_CREATION_DYNAMIC_MDEV=y
BR2_ROOTFS_OVERLAY="board/astria/dev-0/rootfs"
BR2_ROOTFS_POST_BUILD_SCRIPT="board/astria/dev-0/scripts/post.sh"
BR2_ROOTFS_POST_IMAGE_SCRIPT="support/scripts/genimage.sh"
BR2_ROOTFS_POST_SCRIPT_ARGS="-c $(BUILD_DIR)/genimage.cfg"
BR2_TARGET_ROOTFS_EXT2=y
BR2_TARGET_ROOTFS_EXT2_4=y
BR2_TARGET_ROOTFS_EXT2_SIZE="256M"

# Kernel
BR2_LINUX_KERNEL=y
BR2_LINUX_KERNEL_CONFIG_FRAGMENT_FILES="board/astria/dev-0/configs/linux.fragment"
BR2_LINUX_KERNEL_CUSTOM_GIT=y
BR2_LINUX_KERNEL_CUSTOM_REPO_URL="https://github.com/raspberrypi/linux.git"
BR2_LINUX_KERNEL_CUSTOM_REPO_VERSION="rpi-6.12.y"
BR2_LINUX_KERNEL_DEFCONFIG="bcm2711"
BR2_LINUX_KERNEL_DTS_SUPPORT=y
BR2_LINUX_KERNEL_INTREE_DTS_NAME="broadcom/bcm2711-rpi-cm4"
BR2_LINUX_KERNEL_NEEDS_HOST_OPENSSL=y

# Packages
BR2_PACKAGE_BUSYBOX_SHOW_OTHERS=y # Allow more busybox options
BR2_SYSTEM_BIN_SH_ZSH=y # Use zsh instead of busybox's ash
BR2_PACKAGE_CAN_UTILS=y
BR2_PACKAGE_DCRON=y
BR2_PACKAGE_DROPBEAR=y # DEV: ssh
BR2_PACKAGE_E2FSPROGS=y
BR2_PACKAGE_E2FSPROGS_RESIZE2FS=y
BR2_PACKAGE_HTOP=y
BR2_PACKAGE_IPERF3=y
BR2_PACKAGE_KMOD=y
BR2_PACKAGE_KMOD_TOOLS=y
BR2_PACKAGE_LIBGPIOD=y
BR2_PACKAGE_LIBGPIOD_TOOLS=y
BR2_PACKAGE_OPENCV3=y
BR2_PACKAGE_OPENCV3_LIB_PYTHON=y
BR2_PACKAGE_OPENOCD=y
BR2_PACKAGE_NEOFETCH=y
BR2_PACKAGE_NTP=y
BR2_PACKAGE_PYTHON3=y
BR2_PACKAGE_PYTHON3_PY_PYC=y
BR2_PACKAGE_PYTHON_BLINKER=y
BR2_PACKAGE_PYTHON_CAN=y
BR2_PACKAGE_PYTHON_CLICK=y
BR2_PACKAGE_PYTHON_FLASK=y
BR2_PACKAGE_PYTHON_FLASK_CORS=y
BR2_PACKAGE_PYTHON_ITSDANGEROUS=y
BR2_PACKAGE_PYTHON_JINJA2=y
BR2_PACKAGE_PYTHON_MARKUPSAFE=y
BR2_PACKAGE_PYTHON_NUMPY=y
BR2_PACKAGE_PYTHON_SERIAL=y
BR2_PACKAGE_PYTHON_WERKZEUG=y
BR2_PACKAGE_RPI_FIRMWARE=y
BR2_PACKAGE_RPI_FIRMWARE_VARIANT_PI4=y
BR2_PACKAGE_RPI_FIRMWARE_CMDLINE_FILE="board/astria/dev-0/configs/cmdline.txt"
BR2_PACKAGE_RPI_FIRMWARE_CONFIG_FILE="board/astria/dev-0/configs/config.txt"
BR2_PACKAGE_STRESS_NG=y # DEV: load testing
BR2_PACKAGE_XZ=y

# Host packages
BR2_PACKAGE_HOST_DOSFSTOOLS=y
BR2_PACKAGE_HOST_GENIMAGE=y
BR2_PACKAGE_HOST_KMOD_XZ=y
BR2_PACKAGE_HOST_LINUX_HEADERS_CUSTOM_6_6=y
BR2_PACKAGE_HOST_MTOOLS=y
BR2_PACKAGE_HOST_RASPBERRYPI_USBBOOT=y
```
